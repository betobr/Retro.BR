## package/kodi-adsp-biquad-filters/Config.in
```kconfig
config BR2_PACKAGE_KODI_ADSP_BIQUAD_FILTERS
	bool "kodi-adsp-biquad-filters"
	depends on BROKEN # needs update to detect current libasplib
	select BR2_PACKAGE_LIBASPLIB
	select BR2_PACKAGE_LIBPLATFORM
	select BR2_PACKAGE_KODI_PLATFORM
	select BR2_PACKAGE_TINYXML
	help
	  Biquad filter addon for Kodi's AudioDSP-System

	  https://github.com/kodi-adsp/adsp.biquad.filters
```

## package/python-pycryptodomo/Config.in
```kconfig
config BR2_PACKAGE_PYTHON_PYCRYPTODOMO
	bool "python-pycryptodomo"
	select BR2_PACKAGE_GMP
	help
	  PyCrypto is a collection of cryptographic algorithms and
	  protocols, implemented for use from Python.

	  http://www.pycryptodomo.org/
```
